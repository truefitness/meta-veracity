## conf/layer.conf
```bitbake
# We have a conf and classes directory, add to BBPATH
BBPATH := "${BBPATH}:${LAYERDIR}"

# We have a recipes directory, add to BBFILES
BBFILES := "${BBFILES} \
    ${LAYERDIR}/recipes-*/*/*.bb \
	${LAYERDIR}/recipes-*/*/*.bbappend \
	${LAYERDIR}/images/*.bbappend \
	${LAYERDIR}/images/*.bb \
"

BBFILE_COLLECTIONS += "veracity"
BBFILE_PATTERN_veracity := "^${LAYERDIR}/"
BBFILE_PRIORITY_veracity = "6"

LAYERDEPENDS_veracity = "intel"
```

## meta-cedar/conf/layer.conf
```bitbake
# We have a conf and classes directory, add to BBPATH
BBPATH := "${BBPATH}:${LAYERDIR}"

# We have a recipes directory, add to BBFILES
BBFILES := "${BBFILES} ${LAYERDIR}/recipes-*/*/*.bb \
	${LAYERDIR}/recipes-*/*/*.bbappend"

BBFILE_COLLECTIONS += "cedar"
BBFILE_PATTERN_cedar := "^${LAYERDIR}/"
BBFILE_PRIORITY_cedar = "6"

LAYERDEPENDS_cedar = "intel"
```
